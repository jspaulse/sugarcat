/dts-v1/;

/ {
    model = "Test,Test";
    compatible = "nope,nope", "less,nup";
    #address-cells = <1>;
    #size-cells = <1>;
    
    chosen {
	bootargs = "derp,derp mutha derp";
    };

    memory@0x60000000 {
	reg = <0x60000000 0xFFFFFFFF>;
    };
};
